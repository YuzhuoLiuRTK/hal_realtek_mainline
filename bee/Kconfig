## bee/Kconfig
```kconfig
# Copyright (c) 2024 Realtek Semiconductor Corp.
# SPDX-License-Identifier: Apache-2.0

rsource "drivers/Kconfig"
rsource "rtl87x2g/Kconfig"
rsource "rtl8752h/Kconfig"

config REALTEK_BEE_HAS_PCK600
	bool
	help
	  Selected by SoCs whose HAL drives the Arm PCK-600 power control kit.

	  With PCK-600 every peripheral owns its power and clock control and
	  raises its own active request, its registers are retained across a
	  low power state and its pads switch to their sleep configuration in
	  hardware. Devices therefore only have to release their active
	  request to let the system enter a low power state.

	  Without PCK-600 the platform power manager takes the whole SoC down
	  at once, peripheral registers lose their content and pads have to be
	  switched by software, so devices have to save and restore their
	  context around a low power state.

config REALTEK_BT_CONTROLLER_STACK_SIZE
	int "Realtek bt lowstack stack size"
    range 1536 4096
	default 3072
	help
	  This config set the bt lowstack stack size.

config REALTEK_OSIF_TIMER_MAX_COUNT
	int "Max Number of Realtek osif timer to create"
	range 6 4096
	default 10
	help
	  This config set the max number of osif timer to create.

config REALTEK_OSIF_MAX_TASK_PRIORITY
    int
    default 6
    help
      This config CAN NOT be modified. Realtek osif task's priority is restricted to 0 ~ 6.
```
