## bee/drivers/can/Kconfig
```kconfig
# Copyright (c) 2026 Realtek Semiconductor Corp.
# SPDX-License-Identifier: Apache-2.0

config REALTEK_BEE_CAN
	bool "Realtek Bee MCU CAN driver"
	default y
	depends on USE_HAL_REALTEK_BEE_CAN

	select USE_HAL_REALTEK_BEE_RCC
	select USE_HAL_REALTEK_BEE_PINMUX
	select USE_HAL_REALTEK_BEE_NVIC

	help
	  This option enables the CAN driver for Realtek Bee MCU.
```

## bee/drivers/codec/Kconfig
```kconfig
# Copyright (c) 2026 Realtek Semiconductor Corp.
# SPDX-License-Identifier: Apache-2.0

config REALTEK_BEE_CODEC
	bool "Realtek Bee MCU codec driver"
	default y
	depends on USE_HAL_REALTEK_BEE_CODEC

	select USE_HAL_REALTEK_BEE_RCC
	select USE_HAL_REALTEK_BEE_PINMUX
	select USE_HAL_REALTEK_BEE_NVIC

	help
	  This option enables the codec driver for Realtek Bee MCU.
```

## bee/drivers/gpio/Kconfig
```kconfig
# Copyright (c) 2026, Realtek Semiconductor Corporation
# SPDX-License-Identifier: Apache-2.0

config REALTEK_BEE_GPIO
	bool "Realtek Bee MCU gpio driver"
	default y
	depends on USE_HAL_REALTEK_BEE_GPIO

	select USE_HAL_REALTEK_BEE_RCC
	select USE_HAL_REALTEK_BEE_PINMUX
	select USE_HAL_REALTEK_BEE_NVIC

	help
	  This option enables the gpio driver for Realtek Bee MCU.
```

## bee/drivers/i2s/Kconfig
```kconfig
# Copyright (c) 2026 Realtek Semiconductor Corp.
# SPDX-License-Identifier: Apache-2.0

config REALTEK_BEE_I2S
	bool "Realtek Bee MCU i2s driver"
	default y
	depends on USE_HAL_REALTEK_BEE_I2S

	select USE_HAL_REALTEK_BEE_RCC
	select USE_HAL_REALTEK_BEE_PINMUX
	select USE_HAL_REALTEK_BEE_NVIC

	help
	  This option enables the i2s driver for Realtek Bee MCU.
```

## bee/drivers/ir/Kconfig
```kconfig
# Copyright (c) 2026, Realtek Semiconductor Corporation
# SPDX-License-Identifier: Apache-2.0

config REALTEK_BEE_IR
	bool "Realtek Bee MCU ir driver"
	default y
	depends on USE_HAL_REALTEK_BEE_IR

	select USE_HAL_REALTEK_BEE_RCC
	select USE_HAL_REALTEK_BEE_PINMUX
	select USE_HAL_REALTEK_BEE_NVIC

	help
	  This option enables the ir driver for Realtek Bee MCU.
```

## bee/drivers/nvic/Kconfig
```kconfig
# Copyright (c) 2026 Realtek Semiconductor Corp.
# SPDX-License-Identifier: Apache-2.0

config REALTEK_BEE_NVIC
	bool "Realtek Bee MCU nvic driver"
	default y
	depends on USE_HAL_REALTEK_BEE_NVIC

	help
	  This option enables the nvic driver for Realtek Bee MCU.
```

## bee/drivers/pinmux/Kconfig
```kconfig
# Copyright (c) 2026 Realtek Semiconductor Corp.
# SPDX-License-Identifier: Apache-2.0

config REALTEK_BEE_PINMUX
	bool "Realtek Bee MCU pinmux driver"
	default y
	depends on USE_HAL_REALTEK_BEE_PINMUX

	help
	  This option enables the pinmux driver for Realtek Bee MCU.
```

## bee/drivers/qdec/Kconfig
```kconfig
# Copyright (c) 2026 Realtek Semiconductor Corp.
# SPDX-License-Identifier: Apache-2.0

config REALTEK_BEE_AON_QDEC
	bool "Realtek Bee MCU aon qdec driver"
	default y
	depends on USE_HAL_REALTEK_BEE_AON_QDEC

	select USE_HAL_REALTEK_BEE_RCC
	select USE_HAL_REALTEK_BEE_PINMUX
	select USE_HAL_REALTEK_BEE_NVIC

	help
	  This option enables the aon qdec driver for Realtek Bee MCU.

config REALTEK_BEE_QDEC
	bool "Realtek Bee MCU qdec driver"
	default y
	depends on USE_HAL_REALTEK_BEE_QDEC

	select USE_HAL_REALTEK_BEE_RCC
	select USE_HAL_REALTEK_BEE_PINMUX
	select USE_HAL_REALTEK_BEE_NVIC

	help
	  This option enables the qdec driver for Realtek Bee MCU.
```

## bee/drivers/rtc/Kconfig
```kconfig
# Copyright (c) 2026, Realtek Semiconductor Corporation
# SPDX-License-Identifier: Apache-2.0

config REALTEK_BEE_RTC
	bool "Realtek Bee MCU rtc driver"
	default y
	depends on USE_HAL_REALTEK_BEE_RTC

	select USE_HAL_REALTEK_BEE_RCC
	select USE_HAL_REALTEK_BEE_PINMUX
	select USE_HAL_REALTEK_BEE_NVIC

	help
	  This option enables the rtc driver for Realtek Bee MCU.
```

## bee/drivers/sdhc/Kconfig
```kconfig
# Copyright (c) 2026 Realtek Semiconductor Corp.
# SPDX-License-Identifier: Apache-2.0

config REALTEK_BEE_SDHC
	bool "Realtek Bee MCU sdhc driver"
	default y
	depends on USE_HAL_REALTEK_BEE_SDHC

	select USE_HAL_REALTEK_BEE_RCC
	select USE_HAL_REALTEK_BEE_PINMUX
	select USE_HAL_REALTEK_BEE_NVIC

	help
	  This option enables the sdhc driver for Realtek Bee MCU.
```

## bee/drivers/spi/Kconfig
```kconfig
# Copyright (c) 2026, Realtek Semiconductor Corporation
# SPDX-License-Identifier: Apache-2.0

config REALTEK_BEE_SPI
	bool "Realtek Bee MCU spi driver"
	default y
	depends on USE_HAL_REALTEK_BEE_SPI

	select USE_HAL_REALTEK_BEE_RCC
	select USE_HAL_REALTEK_BEE_PINMUX
	select USE_HAL_REALTEK_BEE_NVIC

	help
	  This option enables the spi driver for Realtek Bee MCU.
```

## bee/drivers/tim/Kconfig
```kconfig
# Copyright (c) 2026 Realtek Semiconductor Corp.
# SPDX-License-Identifier: Apache-2.0

config REALTEK_BEE_TIM
	bool "Realtek Bee MCU tim driver"
	default y
	depends on USE_HAL_REALTEK_BEE_TIM

	select USE_HAL_REALTEK_BEE_RCC
	select USE_HAL_REALTEK_BEE_PINMUX
	select USE_HAL_REALTEK_BEE_NVIC

	help
	  This option enables the tim driver for Realtek Bee MCU.

config REALTEK_BEE_ENHTIM
	bool "Realtek Bee MCU enhtim driver"
	default y
	depends on USE_HAL_REALTEK_BEE_ENHTIM

	select USE_HAL_REALTEK_BEE_RCC
	select USE_HAL_REALTEK_BEE_PINMUX
	select USE_HAL_REALTEK_BEE_NVIC

	help
	  This option enables the enhtim driver for Realtek Bee MCU.
```

## bee/drivers/uart/Kconfig
```kconfig
# Copyright (c) 2026, Realtek Semiconductor Corporation
# SPDX-License-Identifier: Apache-2.0

config REALTEK_BEE_UART
	bool "Realtek Bee MCU uart driver"
	default y
	depends on USE_HAL_REALTEK_BEE_UART

	select USE_HAL_REALTEK_BEE_RCC
	select USE_HAL_REALTEK_BEE_PINMUX
	select USE_HAL_REALTEK_BEE_NVIC

	help
	  This option enables the uart driver for Realtek Bee MCU.
```
